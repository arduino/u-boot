// SPDX-License-Identifier: GPL-2.0

/*
 * U-Boot has no driver for the USB3 QMP PHY of the QCM2290. Without the
 * PHY's pipe clock the controller's endpoint commands time out ("failed
 * to enable ep0out"), so run the controller at high speed from the UTMI
 * clock, as Linux does on boards without a superspeed PHY.
 */
&usb {
	qcom,select-utmi-as-pipe-clk;
};

&usb_dwc3 {
	maximum-speed = "high-speed";
	phys = <&usb_hsphy>;
	phy-names = "usb2-phy";
};
